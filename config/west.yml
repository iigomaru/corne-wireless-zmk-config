## config/west.yml
```yaml
manifest:
  remotes:
    - name: andrewjrae
      url-base: https://github.com/andrewjrae
  projects:
    - name: zmk
      remote: andrewjrae
      revision: keycode-pre-releasing
      import: app/west.yml
  self:
    path: config
```
